## config/west.yml
```yaml
manifest:
  remotes:
    - name: zmkfirmware
      url-base: https://github.com/zmkfirmware
  remotes:
    - name: benvallack
      url-base: https://github.com/benvallack
  projects:
    - name: zmk
      # remote: zmkfirmware
      # revision: main
      remote: benvallack
      revision: repeatrollfix-tapdance-macro-mouse-dongle
      import: app/west.yml
  self:
    path: config
```
